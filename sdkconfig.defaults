## sdkconfig.defaults
```kconfig
CONFIG_ESP_DEFAULT_CPU_FREQ_MHZ_80=y

# Increase main task stack size
# CONFIG_ESP_MAIN_TASK_STACK_SIZE=8192

CONFIG_HTTPD_MAX_REQ_HDR_LEN=1024

# Websocket
CONFIG_HTTPD_WS_SUPPORT=y

# Enable filesystem
CONFIG_PARTITION_TABLE_CUSTOM=y
CONFIG_PARTITION_TABLE_CUSTOM_FILENAME="partitions.csv"
CONFIG_PARTITION_TABLE_FILENAME="partitions.csv"

# Enable FreeRTOS stats formatting functions, needed for 'tasks' command
#CONFIG_FREERTOS_USE_TRACE_FACILITY=y
#CONFIG_FREERTOS_USE_STATS_FORMATTING_FUNCTIONS=y
#CONFIG_FREERTOS_GENERATE_RUN_TIME_STATS=y
#CONFIG_COMPILER_STACK_CHECK_MODE_ALL=y
#CONFIG_STACK_CHECK_ALL=y

CONFIG_ESPTOOLPY_FLASHSIZE_4MB=y
CONFIG_ESPTOOLPY_FLASHMODE_QIO=y

# On chips with USB serial, disable secondary console which does not make sense when using console component
CONFIG_ESP_CONSOLE_SECONDARY_NONE=y

#CONFIG_LOG_COLORS=y
#CONFIG_LOG_MAXIMUM_LEVEL=4
#CONFIG_LOG_DEFAULT_LEVEL_DEBUG=y
#CONFIG_FREERTOS_HZ=1000

CONFIG_BOOTLOADER_LOG_LEVEL=3

#2.9v
CONFIG_ESP_BROWNOUT_DET_LVL_SEL_4=y
```
